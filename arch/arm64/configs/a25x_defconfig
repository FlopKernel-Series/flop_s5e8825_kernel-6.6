## drivers/clocksources/Kconfig
```kconfig
# SPDX-License-Identifier: GPL-2.0-only
config CLKSRC_EXYNOS_MCT_V1
	tristate "Exynos multi core timer v1 driver"
	depends on ARM || ARM64
	help
	  Support for Multi Core Timer controller on Exynos SoCs.
```

## drivers/gpu/drm/samsung/panel/db7f2010b/kunit_test/Kconfig
```kconfig
config DB7F2010B_A26X_TEST
	bool "KUnit test for tft_common ddi driver"
	depends on SEC_KUNIT
	help
	  TODO: Describe config fully.
```

## drivers/gpu/drm/samsung/panel/s6e8fc3/kunit_test/Kconfig
```kconfig
config S6E8FC3_A26X_TEST
	bool "KUnit test for tft_common ddi driver"
	depends on SEC_KUNIT
	help
	  TODO: Describe config fully.
```

## drivers/gud/Kconfig
```kconfig
#
# Mobicore Configuration
#
source "$(KCONFIG_EXT_SOC_PREFIX)drivers/gud/gud-s5e8825/Kconfig"
```

## drivers/misc/samsung/Kconfig
```kconfig
source "$(KCONFIG_EXT_SOC_PREFIX)drivers/misc/samsung/scsc/Kconfig"
source "$(KCONFIG_EXT_SOC_PREFIX)drivers/misc/samsung/scsc_bt/Kconfig"
```

## drivers/nfc/Kconfig
```kconfig
# SPDX-License-Identifier: GPL-2.0-only
#
# Near Field Communication (NFC) devices
#

menu "Near Field Communication (NFC) devices"
	depends on NFC

config NFC_TRF7970A
	tristate "Texas Instruments TRF7970a NFC driver"
	depends on SPI && NFC_DIGITAL && GPIOLIB
	help
	  This option enables the NFC driver for Texas Instruments' TRF7970a
	  device. Such device supports 5 different protocols: ISO14443A,
	  ISO14443B, FeLiCa, ISO15693 and ISO18000-3.

	  Say Y here to compile support for TRF7970a into the kernel or
	  say M  to compile it as a module. The module will be called
	  trf7970a.ko.

config NFC_MEI_PHY
	tristate "MEI bus NFC device support"
	depends on INTEL_MEI && NFC_HCI
	help
	  This adds support to use an mei bus nfc device. Select this if you
	  will use an HCI NFC driver for an NFC chip connected behind an
	  Intel's Management Engine chip.

	  If unsure, say N.

config NFC_SIM
	tristate "NFC hardware simulator driver"
	depends on NFC_DIGITAL
	help
	  This driver declares two virtual NFC devices supporting NFC-DEP
	  protocol. An LLCP connection can be established between them and
	  all packets sent from one device is sent back to the other, acting as
	  loopback devices.

	  If unsure, say N.

config NFC_PORT100
	tristate "Sony NFC Port-100 Series USB device support"
	depends on USB
	depends on NFC_DIGITAL
	help
	  This adds support for Sony Port-100 chip based USB devices such as the
	  RC-S380 dongle.

	  If unsure, say N.

config NFC_VIRTUAL_NCI
	tristate "NCI device simulator driver"
	depends on NFC_NCI
	help
	  NCI virtual device simulates a NCI device to the user.
	  It can be used to validate the NCI module and applications.
	  This driver supports communication between the virtual NCI device and
	  module.

	  If unsure, say N.

source "drivers/nfc/fdp/Kconfig"
source "drivers/nfc/pn544/Kconfig"
source "drivers/nfc/pn533/Kconfig"
source "drivers/nfc/microread/Kconfig"
source "drivers/nfc/nfcmrvl/Kconfig"
source "drivers/nfc/st21nfca/Kconfig"
source "drivers/nfc/st-nci/Kconfig"
source "drivers/nfc/nxp-nci/Kconfig"
source "drivers/nfc/s3fwrn5/Kconfig"
source "drivers/nfc/st95hf/Kconfig"

#
# near field communication configuration
#
config SAMSUNG_NFC
	tristate "Samsung NFC driver"
	default n
	help
	  Say Y here if you want to build support for NFC (Near field
	  communication) devices.
	  To compile this support as a module, choose M here: the module will
	  be called nfc.

config NFC_ST21NFC
	bool "STM's ST21NFC Feature"
	default n
	help
	  STM's ST21NFC Near Field Communication controller support
	  This option enables device driver support for the NFC.
	  It is used by many services. NFC is fully controlled using I2C
	  to communicate the AP chip.

config NFC_ST54SPI_ESE_SUPPORT
	tristate "STM's Secure Element protocol driver (SPI) devices"
	depends on SPI
	help
	  This enables the Secure Element driver for ST21NFC based devices.
	  If unsure, say N.
	  This selects Secure Element support.
	  If you want NFC support, you should say Y here and
	  also to your specific host controller driver.

config ESE_USE_TZ_API
        bool "use tz api"
        depends on NFC_ST54SPI_ESE_SUPPORT
        default n
        help
          Enable when using TZ API.
	  You should select this feature if your NFC product
          uses S.LSI AP and TZ API.
	  Say Y here to compile support for TZ API.

config SEC_NFC_LOGGER
        bool "NFC logger"
        default n
        help
          Enable NFC log.
          NFC log will be recorded at proc folder.
          but will not included at dumpstate log.
          so need to copy this file to log folder.

config NFC_LOGGER_LOWMEM
       bool "NFC logger low memory"
       default n
       help
         Reduces NFC log buffer size.
         This option reduces the size of the nfc log buffer in order to save memory on low-memory devices.
         By reducing its size, we can free up memory for other purposes,
         but it may also result in some log messages being lost if the buffer fills up quickly.

config NFC_QTI_I2C
        tristate "QTI NCI based NFC I2C Driver for ST21NFC"
        depends on I2C
        help
          This enables the NFC driver for ST21NFC based devices.
          This is for I2C connected version. NCI protocol logic
          resides in the usermode and it has no other NFC dependencies.

          If unsure, say N.

endmenu
```

## drivers/samsung/Kconfig
```kconfig
source "drivers/samsung/pm/Kconfig"

source "drivers/samsung/debug/Kconfig"

source "drivers/samsung/factory/Kconfig"

comment "Samsung sysfs Feature"
config DRV_SAMSUNG
	tristate "Samsung sec class/sysfs Feature"
	default n
	help
	  Samsung sysfs name 'sec' directory create.

# Copyright (c) 2010-2026 Samsung Electronics Co., Ltd.
#               http://www.samsung.com/
#
# Licensed under GPLv2

config SEC_REBOOT
	tristate "Enable Samsung reboot features"
	default n
	help
	  Samsung TN reboot extension Feature. Do additional work when reboot.

config SEC_KEY_NOTIFIER
	tristate "Enable Samsung key event notifier"
	default n
	help
	  Samsung Key input event notifier

config SEC_KN_WATCH
	bool "Change keys to support watch in event notifier"
	default n
	help
		Enable this option for watch devices.
		This will change the hold, primary, and secondary key to
		support crash key and hard reset hook in watch devices.

		          |     Phone      |     Watch
		------------------------------------------
		Hold      | KEY_VOLUMEDOWN | KEY_APPSELECT
		------------------------------------------
		Primary   | KEY_POWER      | KEY_APPSELECT
		------------------------------------------
		Secondary | KEY_VOLUMEUP   | KEY_POWER
		------------------------------------------
```

## drivers/samsung/factory/Kconfig
```kconfig
config SEC_FACTORY
	bool "SAMSUNG Factory build option"
	default n
	help
	  Include some codes for Factory binary.
	  This option is enabled by Factory build option.
	  In samsung build script, '-F' enables this option.

config SEC_FACTORY_INTERPOSER
	bool "Samsung Factory interposer binary"
	default n
	help
	  Samsung Factory interposer binary.
	  In samsung build script, '-g' enables this option.

config SEC_RELOC_GPIO
	tristate "Samsung Legacy-Style Relocated GPIO Interface for Factory Mode"
	default n
	depends on DRV_SAMSUNG
	help
	  Samsung Legacy-Style Relocated GPIO Interface for Factory Mode
```

## drivers/soc/samsung/exynos/Kconfig
```kconfig
config SOC_S5E8825
	bool "Samsung S5E8825"
	select ARCH_EXYNOS
	help
	  Support Samsung SOC S5E8825.

# SPDX-License-Identifier: GPL-2.0-only
#
# Samsung SoC drivers
#

config EXYNOS_CHIPID_V2
	tristate "Exynos Chipid controller driver v2"
	depends on ARCH_EXYNOS
	help
	  Exynos chipid V2 driver.
	  Support newly added soc chipid.

config EXYNOS_USI_V2
	tristate "Enable Exynos Universal Serial Interface version 2"

config EXYNOS_PMU_IF
	tristate "Exynos PMU controller Interface driver"
	help
	Support PMU register API for Exynos SoC.
	select EXYNOS_PMU_ARM_DRIVERS if ARM && ARCH_EXYNOS

config CAL_IF
	tristate "Exynos Chip Abstraction Layer Interface"
	help
	Support CMU CAL for Exynos SoC.

config EXYNOS_DEBUG_INFO
	bool "Exynos Debug infromation"
	default y
	help
	Support printing Exynos Debug information.

config CMUCAL
	tristate "Exynos CMU Chip Abstraction Layer"
	default y
	depends on CAL_IF
	help
	Support CMUCAL for Exynos SoC.

config CMUCAL_DEBUG
	tristate "CMUCAL Debug Interface"
	default y
	depends on CMUCAL

config CMUCAL_QCH_IGNORE_SUPPORT
	tristate "CMUCAL QCH IGNORE Support"
	default y
	depends on CMUCAL

config PMUCAL
        bool "Exynos PMU Chip Abstraction Layer"
        depends on CAL_IF
        default y
        help
        Support PMUCAL for Exynos SoC.

config CHUB_PMUCAL
        tristate "Exynos PMU(for CHUB) Chip Abstraction Layer"
        default n
        depends on CAL_IF
        help
        Support CHUB_PMUCAL for Exynos SoC.

config PMUCAL_DBG
        tristate "Exynos PMUCAL debugging interface"
        depends on PMUCAL
        help
        Support PMUCAL debugging for Exynos SoC.

config CP_PMUCAL
        tristate "Exynos PMU(for CP) Chip Abstraction Layer"
        default n
        depends on CAL_IF
        help
        Support CP_PMUCAL for Exynos SoC.

config GNSS_PMUCAL
        tristate "Exynos PMU(for GNSS) Chip Abstraction Layer"
        depends on CAL_IF
        help
        Support GNSS_PMUCAL for Exynos SoC.

config EXYNOS_FLEXPMU_DBG
        tristate "Exynos FLEXPMU debugging interface"
	depends on PMUCAL
	help
	Support FLEXPMU for Exynos SoC.

config PMUCAL_CMU_INIT
		tristate "CMU_INIT in kernel"
	default n
	help
	Support PMUCAL_CMU_INIT for Exynos SoC.

config EXYNOS_PM_DOMAINS
	bool "Exynos PM domains" if COMPILE_TEST
	depends on (ARCH_EXYNOS && PM_GENERIC_DOMAINS) || COMPILE_TEST

config SAMSUNG_PM_DEBUG
	bool "Samsung PM Suspend debug"
	depends on PM && DEBUG_KERNEL
	depends on PLAT_S3C24XX || ARCH_S3C64XX || ARCH_S5PV210
	depends on DEBUG_S3C24XX_UART || DEBUG_S3C2410_UART
	depends on DEBUG_LL && MMU
	help
	  Say Y here if you want verbose debugging from the PM Suspend and
	  Resume code. See <file:Documentation/arm/samsung-s3c24xx/suspend.rst>
	  for more information.

config CMU_EWF
	tristate "exynos early wakeup force enable"
	depends on CAL_IF
	default n
	help
	Support CMUEWF for Exynos SoC.

config EXYNOS_PD
	tristate "Exynos PM domain Support"
        depends on CAL_IF && CMUCAL
	depends on PM
	select PM_GENERIC_DOMAINS

config EXYNOS_PD_DBG
	tristate "Exynos PM domain Support"
        depends on CAL_IF && CMUCAL
	depends on PM
	select PM_GENERIC_DOMAINS

config EXYNOS_PD_EL3
	tristate "Exynos PD Save/Restore"
	default m
	help
	Support Exynos Power Domain Save/Restore

config EXYNOS_PM
	tristate "Enable Exynos PM"
	help
	Support EXYNOS_PM for Exynos SoC.

config EXYNOS_PM_DVS
	tristate "Enable Exynos dynamic voltage setting"
	help
	Support regulator DVS during sleep/wakeup

config ECT
	tristate "Enable Exynos Characteristic Table File"
	default n
	help
	Support ECT for Exynos SoC.

config ACPM_DVFS
        tristate "Exynos ACPM DVFS manager"
        depends on CAL_IF && CMUCAL
        default n
        help
        Support ACPM DVFS for Exynos SoC.

config SHOW_ASV
        tristate "Support ASV Sysfs Node"
        depends on CAL_IF
        default y
        help
        Support ASV Sysfs Node

config EXYNOS_DEBUG_FREQ
	tristate "check constraint freq and print log"
	depends on CAL_IF
	default m
	help
	  If this config is set, check constraint freq every time which cpufreq,

config EXYNOS_PM_QOS
	tristate "Exynos PM QOS"
	help
	  Support Exynos PM QOS

config EXYNOS_DVFS_MANAGER
	tristate "Exynos DVFS Manager"
	help
	  Enable DVFS Manager for Exynos SoC.
	  This module controls constraint between each DVFS domains.

config EXYNOS_MEMORY_LOGGER
	tristate "Exynos Memory Logger"
	default n
	help
	  Exynos Memory Logger API is provided by memlog driver.

	  Memlog means exynos memory Logger driver. The memlog provides
	  the logging method desired by each driver in memory for debugging,
	  memlog provides APIs for memory logging.

config EXYNOS_IMGLOADER
	tristate "Exynos Image Loader"
	default n
	help
	  Enable Image Loader for Exynos SoC.

config EXYNOS_MCINFO
        tristate "Exynos memory controller information"

config MCINFO_SYSFS
        bool "Exynos memory controller information sysfs"
        depends on EXYNOS_MCINFO
        default y if SYSFS

config EXYNOS_SYSTEM_EVENT
	tristate "Exynos System Event Framework"
	default n
	help
	  Enable System Event Framework for Exynos SoC.

config EXYNOS_CPUHP
	tristate "CPU Hotplug driver support"
	default n
	help
	  Support CPU Hotplug interface for Exynos SoC.

config EXYNOS_CPUPM
	tristate "Exynos CPU Power Management driver"
	depends on ARCH_EXYNOS && PMUCAL
	default n
	help
	  Support Exynos CPU Power Control for EXYNOS SoC.

config EXYNOS_BCM_DBG
	tristate "EXYNOS_BCM_DBG driver support"
	help
	  Enable exynos-bcm_dbg driver support

config EXYNOS_BCM_DBG_GNR
	tristate "EXYNOS_BCM_DBG_GNR driver support"
	help
	  Enable exynos-bcm_dbg driver support

config EXYNOS_BCM_DBG_AUTO
	tristate "EXYNOS_BCM_DBG_AUTO support"
	default n
	depends on EXYNOS_BCM_DBG
	depends on !(USE_SIGNED_BINARY)
	help
	  Enable exynos-bcm_dbg_auto support

config EXYNOS_BCM_DBG_DUMP
	tristate "EXYNOS_BCM_DBG dump support"
	depends on EXYNOS_BCM_DBG
	help
	  Enable exynos-bcm_dbg dump support

config EXYNOS_AFM
	tristate "Exynos AFM Handler"
	depends on CPU_FREQ
	default n
	help
	  Enable AFM handler for Exynos SoC.

config EXYNOS_UFCC
	tristate "User Frequency & C-state Control"
	depends on EXYNOS_CPUPM && ARM_EXYNOS_ACME
	default n
	help
	  Control Frequency & C-state by user

config EXYNOS_PPMPU_FAIL_DETECTOR
	tristate "Exynos PPMPU Fail Detector"
	default m
	help
	  Support Exynos PPMPU Fail Detector

config EXYNOS_PPMPU_ILLEGAL_READ_LOGGING
	bool "Logging PPMPU Read Fail Information"
	depends on EXYNOS_PPMPU_FAIL_DETECTOR
	default n
	help
	  PPMPU fail information of illegal reads will be printed
	  by the Kernel logging system.

config EXYNOS_PPMPU_ILLEGAL_ACCESS_PANIC
	bool "Kernel Panic over PPMPU Illegal Access"
	depends on EXYNOS_PPMPU_FAIL_DETECTOR
	default y
	help
	  Kernel panic will occur in case that PPMPU illegal
	  access is detected.

source "drivers/soc/samsung/exynos/acpm/Kconfig"
source "drivers/soc/samsung/exynos/exynos-el2/Kconfig"
source "drivers/soc/samsung/exynos/security/Kconfig"
```

## drivers/soc/samsung/exynos/security/Kconfig
```kconfig
# SPDX-License-Identifier: GPL-2.0-only
#
# Samsung SoC drivers
#

config EXYNOS_SECURE_LOG
        tristate "Exynos Secure Log"
        default m
        help
        Support Exynos Secure Log

config EXYNOS_TZASC_FAIL_DETECTOR
        tristate "Exynos TZASC Fail Detector"
        default m
        help
        Support Exynos TZASC Fail Detector

config EXYNOS_SEH
        tristate "Exynos Smart Exception Handler"
        default m
        help
        Support Exynos Smart Exception Handler

config EXYNOS_CRYPTOMANAGER
	tristate "Exynos Samsung CryptoManager"
	default m
	help
	  Support Exynos Samsung CryptoManager

config HW_RANDOM_EXYNOS_SWD
	tristate "EXYNOS SWD HW random number generator support"
	depends on ARCH_EXYNOS
	default m
	help
	  This driver provides kernel-side support for TRNG hardware
	  found in secure world by using smc call

	  To compile this driver as a module, choose M here: the
	  module will be called exynos-rng.
	  If unsure, say Y.

config EXYNOS_SDM
	tristate "Exynos Samsung Security Dump Manager"
	depends on DEBUG_SNAPSHOT
	default m
	help
	  Support Exynos Samsung Security Dump Manager

config EXYNOS_CONTENT_PATH_PROTECTION
	tristate "Exynos Secure Memory Support"
	depends on ARCH_EXYNOS
	default m
	help
	  Support Exynos Secure Memory Memory for content path protection
```
