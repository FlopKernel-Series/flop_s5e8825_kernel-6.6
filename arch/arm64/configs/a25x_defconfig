## arch/arm64/configs/lego_defconfig
```kconfig
CONFIG_SEC_PANEL_NOTIFIER_V2=m
CONFIG_PDIC_S2MF301=m
CONFIG_S2MF301_PDIC_TRY_SNK=y
CONFIG_S2MF301_TYPEC_WATER=y
CONFIG_USDM_PANEL_OLED_COMMON=m
CONFIG_USDM_PANEL_DB7F2010B=m
CONFIG_PDIC_SLSI_NON_MCU=m
CONFIG_PDIC_PD30=y
CONFIG_SUPPORT_USB_TYPEC_OPS=y
# CONFIG_SECURITY_DEFEX is not set
# CONFIG_PROCA is not set
CONFIG_INPUT_SEC_INPUT=m
CONFIG_INPUT_SEC_NOTIFIER=m
CONFIG_SEC_DEBUG_TSP_LOG=m
CONFIG_TOUCHSCREEN_DUMP_MODE=m
CONFIG_SEC_INPUT_HEADER=y
# CONFIG_INPUT_SEC_SECURE_TOUCH is not set
# CONFIG_INPUT_SEC_TRUSTED_TOUCH is not set
CONFIG_INPUT_TOUCHSCREEN_TCLMV2=m
# CONFIG_SEC_INPUT_MULTI_DEVICE is not set
CONFIG_SEC_INPUT_RAWDATA=m
CONFIG_VIBRATOR_VIB_INFO=m
CONFIG_SEC_NFC_LOGGER=y
# CONFIG_NFC_LOGGER_LOWMEM is not set
# CONFIG_MEMORY_ZEROISATION is not set
CONFIG_DEV_RIL_BRIDGE=m
CONFIG_SEC_VIBRATOR=m
CONFIG_SUPPORT_DROPDUMP=m
CONFIG_MUIC_NOTIFIER=m
CONFIG_HICCUP_CC_DISABLE=y
CONFIG_HICCUP_CHARGER=y
CONFIG_MUIC_COMMON_SYSFS=y
CONFIG_MUIC_AFC_RETRY=y
CONFIG_MUIC_HV=y
CONFIG_MUIC_SUPPORT_PDIC=y
CONFIG_MUIC_USE_MODULE_PARAM=y
CONFIG_USE_MUIC=y
CONFIG_SEC_INPUT_BOOSTER=m
CONFIG_SEC_INPUT_BOOSTER_MODE=y
CONFIG_SEC_INPUT_BOOSTER_SLSI=y
CONFIG_SEC_INPUT_BOOSTER_HANDLER=y
CONFIG_SEC_STI=y
CONFIG_USB_NOTIFY_LAYER=m
CONFIG_USB_DEBUG_DETAILED_LOG=y
CONFIG_USB_EXTERNAL_NOTIFY=y
CONFIG_USB_HMT_SAMSUNG_INPUT=y
CONFIG_USB_HOST_NOTIFY=y
CONFIG_USB_HOST_SAMSUNG_FEATURE=y
CONFIG_USB_HW_PARAM=y
CONFIG_USB_INTERFACE_LPM_LIST=y
CONFIG_USB_NOTIFY_PROC_LOG=y
CONFIG_USB_USING_ADVANCED_USBLOG=y
CONFIG_ZRAM=m
CONFIG_SB_CORE=m
CONFIG_SB_PQUEUE=y
CONFIG_SB_NOTIFY=y
CONFIG_SB_SYSFS=y
CONFIG_SB_VOTE=y
CONFIG_SEC_KQ_MESH=m
CONFIG_KPERFMON=y
CONFIG_KPERFMON_BUILD=m
CONFIG_USDM_PANEL_S6E8FC3=m
CONFIG_ANDROID_SWITCH=m
# CONFIG_ANDROID_SWITCH_GPIO is not set
CONFIG_VBUS_NOTIFIER=m
# CONFIG_MZ_TEE_DRIVER is not set
CONFIG_USB_TYPEC_MANAGER_NOTIFIER=m
CONFIG_IF_CB_MANAGER=m
CONFIG_SENSORS_FINGERPRINT=m
CONFIG_MUIC_PLATFORM=m
CONFIG_HV_MUIC_VOLTAGE_CTRL=y
CONFIG_MUIC_SUPPORT_POWERMETER=y
CONFIG_MUIC_SUPPORT_PRSWAP=y
CONFIG_SEC_ABC_SPEC_TYPE1=m
CONFIG_DRM_PANEL_MCD_COMMON=m
# CONFIG_DRM_PANEL_SAMSUNG_COMMON is not set
CONFIG_USDM_PANEL_JSON=y
CONFIG_PDIC_NOTIFIER=m
CONFIG_PDIC_USE_MODULE_PARAM=y
CONFIG_SEC_ABC=m
CONFIG_SEC_ABC_HUB=m
CONFIG_SEC_ABC_COMMON=m
CONFIG_SEC_ABC_HUB_CORE=m
CONFIG_SEC_ABC_HUB_BOOTC=m
CONFIG_SEC_ABC_MOTTO=m
CONFIG_USB_NOTIFIER=m
CONFIG_MFD_S2MF301=m
CONFIG_CHARGER_NU2111A=m
CONFIG_REGULATOR_FIXED_VOLTAGE=y
CONFIG_SAMSUNG_NFC=m
CONFIG_NFC_ST21NFC=y
# CONFIG_ESE_USE_TZ_API is not set
# CONFIG_NFC_ST54SPI_ESE_SUPPORT is not set
CONFIG_MUIC_S2MF301=m
CONFIG_HV_MUIC_S2MF301_AFC=y
CONFIG_MUIC_S2MF301_RID=y
CONFIG_TOP_S2MF301=y
CONFIG_FUELGAUGE_S2MF301=m
CONFIG_UI_SOC_PROLONGING=y
CONFIG_FUELGAUGE_S2MF301_USE_5MILLIOHM=y
CONFIG_IIO=y
CONFIG_IIO_BUFFER=y
CONFIG_SHUB=m
CONFIG_STAR_K250A_LEGO=m
CONFIG_SEC_SNVM_PLATFORM_DRV=y
# CONFIG_SEC_SNVM_I2C_CLOCK_CONTROL is not set
CONFIG_SEC_SNVM_WAKELOCK_METHOD=0
# CONFIG_STAR_MEMORY_LEAK is not set
CONFIG_SENSORS_EC6XX=m
CONFIG_SENSORS_FINGERPRINT_MODULE=y
CONFIG_FINGERPRINT_SECURE=y
CONFIG_SENSORS_FINGERPRINT_LSI=y
CONFIG_DC_VIBRATOR=m
CONFIG_TOUCHSCREEN_FTS_FT3519=m
CONFIG_SENSORS_SUPPORT_SLSI=y
CONFIG_SENSORS_ISG6320=m
# CONFIG_SENSORS_ISG6320_SUB is not set
# CONFIG_SENSORS_ISG6320_SUB2 is not set
# CONFIG_SENSORS_ISG6320_WIFI is not set
CONFIG_USE_MULTI_CHANNEL=y
CONFIG_SENSORS_GRIP_FAILURE_DEBUG=y
CONFIG_NANOHUB=m
CONFIG_SHUB_MODULE=y
CONFIG_LSI_IFPMIC=y
CONFIG_CHARGER_S2MF301=m
CONFIG_PM_S2MF301=m
CONFIG_SHIPMODE_BY_VBAT=y
CONFIG_DIRECT_CHARGING=m
CONFIG_BATTERY_SAMSUNG=m
CONFIG_SEC_PD=m
CONFIG_BATTERY_GKI=y
CONFIG_BATTERY_AGE_FORECAST=y
CONFIG_BATTERY_CISD=y
CONFIG_AFC_CHARGER_MODE=y
CONFIG_BATTERY_LOGGING=y
CONFIG_BATTERY_SAMSUNG_REBOOT=y
CONFIG_ENABLE_FULL_BY_SOC=y
CONFIG_STEP_CHARGING=y
CONFIG_SUPPORT_HV_CTRL=y
```

## arch/arm64/configs/model_defconfig
```kconfig
CONFIG_USDM_PANEL=m
CONFIG_USDM_PANEL_DISPLAY_MODE=y
CONFIG_USDM_PANEL_DPUI=y
CONFIG_USDM_PANEL_JSON=y
CONFIG_USDM_MDNIE=y
CONFIG_USDM_PANEL_DIMMING=y
CONFIG_USDM_FACTORY_CCD_TEST=y
CONFIG_USDM_FACTORY_ECC_TEST=y
CONFIG_USDM_FACTORY_DSC_CRC_TEST=y
CONFIG_USDM_PANEL_ID_READ_BY_HSDT=y
CONFIG_USDM_PANEL_ID_READ_REG_04=y
CONFIG_USDM_PANEL_SELF_DISPLAY=y
CONFIG_USDM_PANEL_TESTMODE=y
CONFIG_USDM_PANEL_FREQ_HOP=y
CONFIG_CAMERA_AAX_A26X=y
CONFIG_CAMERA_CIS_JN1_OBJ=m
CONFIG_CAMERA_CIS_IMX258_OBJ=m
CONFIG_CAMERA_CIS_4HA_OBJ=m
CONFIG_CAMERA_CIS_GC02M1_OBJ=m
CONFIG_CAMERA_ACT_DW9818_OBJ=m
CONFIG_CAMERA_OTPROM_SUPPORT_REAR=m
CONFIG_CAMERA_EEPROM_SUPPORT_REAR=m
CONFIG_LEDS_S2MF301_FLASH=m
CONFIG_CAMERA_FLASH_S2MF301_OBJ=m
CONFIG_OIS_USE=y
CONFIG_CAMERA_USE_MCU=y
CONFIG_CAMERA_USE_AOIS=y
CONFIG_SHUB_AOIS=y
CONFIG_RADIO_S5E8825=n
CONFIG_SND_SOC_SAMSUNG_AUDIO=m
CONFIG_SND_SOC_SAMSUNG_EXYNOS8825_AUDIO=m
CONFIG_SND_SOC_SAMSUNG_EXYNOS_AW882XX=m
CONFIG_SND_SOC_FS1816=m
CONFIG_SND_SOC_SAMSUNG_ABOX_CHANGE_RMEM_SIZE=y
CONFIG_SEC_WAKEUP_CPU_ALLOCATOR=m
# CONFIG_TRUSTONIC_TEE is not set
# CONFIG_TZ_NWFS is not set
# CONFIG_TZDEV_BOOST is not set
# CONFIG_ION_FD2PHYS is not set
# CONFIG_TZDEV_DEPLOY_TZAR is not set
# CONFIG_TZDEV_TEST is not set
CONFIG_TZDEV_USE_ARM_CALLING_CONVENTION=y
CONFIG_TZDEV=m
CONFIG_TZDEV_IWI_EVENT=460
CONFIG_TZDEV_IWI_PANIC=461
CONFIG_TZDEV_KTHREADS_SMPBOOT=y
CONFIG_TZDEV_PAGE_MIGRATION=y
CONFIG_TZDEV_SK_MULTICORE=y
CONFIG_TZIRS=y
CONFIG_TZLOG=y
CONFIG_TZLOG_PG_CNT=8
CONFIG_TZ_BOOT_LOG=y
CONFIG_TZ_BOOT_LOG_PG_CNT=1
CONFIG_TZ_TRANSPORT=y
CONFIG_TZ_TRANSPORT_PG_CNT=2
CONFIG_TZDEV_SWD_PANIC_IS_CRITICAL=y
CONFIG_TEEGRIS_VERSION=4
CONFIG_SAMSUNG_TUI=m
CONFIG_SAMSUNG_TUI_LOWLEVEL=y
CONFIG_SAMSUNG_GKI_KERNEL=y
```

## drivers/Kconfig
```kconfig
# SPDX-License-Identifier: GPL-2.0
menu "Device Drivers"

# Keep I/O buses first

source "drivers/amba/Kconfig"
source "drivers/eisa/Kconfig"
source "drivers/pci/Kconfig"
source "drivers/cxl/Kconfig"
source "drivers/pcmcia/Kconfig"
source "drivers/rapidio/Kconfig"


source "drivers/base/Kconfig"

source "drivers/bus/Kconfig"

source "drivers/cache/Kconfig"

source "drivers/connector/Kconfig"

source "drivers/firmware/Kconfig"

source "drivers/gnss/Kconfig"

source "drivers/mtd/Kconfig"

source "drivers/of/Kconfig"

source "drivers/parport/Kconfig"

source "drivers/pnp/Kconfig"

source "drivers/block/Kconfig"

source "drivers/nvme/Kconfig"

source "drivers/misc/Kconfig"

source "drivers/scsi/Kconfig"

source "drivers/ata/Kconfig"

source "drivers/md/Kconfig"

source "drivers/target/Kconfig"

source "drivers/message/fusion/Kconfig"

source "drivers/firewire/Kconfig"

source "drivers/macintosh/Kconfig"

source "drivers/net/Kconfig"

source "drivers/isdn/Kconfig"

# input before char - char/joystick depends on it. As does USB.

source "drivers/input/Kconfig"

source "drivers/char/Kconfig"

source "drivers/i2c/Kconfig"

source "drivers/i3c/Kconfig"

source "drivers/spi/Kconfig"

source "drivers/spmi/Kconfig"

source "drivers/hsi/Kconfig"

source "drivers/pps/Kconfig"

source "drivers/ptp/Kconfig"

source "drivers/pinctrl/Kconfig"

source "drivers/gpio/Kconfig"

source "drivers/w1/Kconfig"

source "drivers/power/Kconfig"

source "drivers/hwmon/Kconfig"

source "drivers/thermal/Kconfig"

source "drivers/watchdog/Kconfig"

source "drivers/ssb/Kconfig"

source "drivers/bcma/Kconfig"

source "drivers/mfd/Kconfig"

source "drivers/regulator/Kconfig"

source "drivers/media/Kconfig"

source "drivers/video/Kconfig"

source "drivers/accel/Kconfig"

source "sound/Kconfig"

source "drivers/hid/Kconfig"

source "drivers/usb/Kconfig"

source "drivers/mmc/Kconfig"

source "drivers/ufs/Kconfig"

source "drivers/memstick/Kconfig"

source "drivers/leds/Kconfig"

source "drivers/accessibility/Kconfig"

source "drivers/infiniband/Kconfig"

source "drivers/edac/Kconfig"

source "drivers/rtc/Kconfig"

source "drivers/dma/Kconfig"

source "drivers/dma-buf/Kconfig"

source "drivers/dca/Kconfig"

source "drivers/uio/Kconfig"

source "drivers/vfio/Kconfig"

source "drivers/vlynq/Kconfig"

source "drivers/virt/Kconfig"

source "drivers/virtio/Kconfig"

source "drivers/vdpa/Kconfig"

source "drivers/vhost/Kconfig"

source "drivers/hv/Kconfig"

source "drivers/xen/Kconfig"

source "drivers/greybus/Kconfig"

source "drivers/comedi/Kconfig"

source "drivers/staging/Kconfig"

source "drivers/platform/Kconfig"

source "drivers/clk/Kconfig"

source "drivers/hwspinlock/Kconfig"

source "drivers/clocksource/Kconfig"

source "drivers/mailbox/Kconfig"

source "drivers/iommu/Kconfig"

source "drivers/remoteproc/Kconfig"

source "drivers/rpmsg/Kconfig"

source "drivers/soundwire/Kconfig"

source "drivers/soc/Kconfig"

source "drivers/devfreq/Kconfig"

source "drivers/extcon/Kconfig"

source "drivers/memory/Kconfig"

source "drivers/iio/Kconfig"

source "drivers/ntb/Kconfig"

source "drivers/pwm/Kconfig"

source "drivers/irqchip/Kconfig"

source "drivers/ipack/Kconfig"

source "drivers/reset/Kconfig"

source "drivers/phy/Kconfig"

source "drivers/powercap/Kconfig"

source "drivers/mcb/Kconfig"

source "drivers/perf/Kconfig"

source "drivers/ras/Kconfig"

source "drivers/thunderbolt/Kconfig"

source "drivers/android/Kconfig"

source "drivers/gpu/trace/Kconfig"

source "drivers/nvdimm/Kconfig"

source "drivers/dax/Kconfig"

source "drivers/nvmem/Kconfig"

source "drivers/hwtracing/Kconfig"

source "drivers/fpga/Kconfig"

source "drivers/fsi/Kconfig"

source "drivers/tee/Kconfig"

source "drivers/mux/Kconfig"

source "drivers/opp/Kconfig"

source "drivers/siox/Kconfig"

source "drivers/slimbus/Kconfig"

source "drivers/interconnect/Kconfig"

source "drivers/counter/Kconfig"

source "drivers/most/Kconfig"

source "drivers/peci/Kconfig"

source "drivers/hte/Kconfig"

source "drivers/cdx/Kconfig"


source "drivers/clocksources/Kconfig"
source "drivers/soc/samsung/exynos/Kconfig"
source "drivers/soc/samsung/exynos/cpif/Kconfig"
source "drivers/soc/samsung/exynos/gnssif/Kconfig"
source "drivers/iommu/samsung/Kconfig"
source "drivers/dma-buf/heaps/samsung/Kconfig"
source "drivers/dma/samsung/Kconfig"
source "drivers/bts/Kconfig"
source "drivers/power/reset/exynos/Kconfig"
source "drivers/gpu/arm/Kconfig"
source "drivers/dpu/Kconfig"
source "drivers/dpu/panel/Kconfig"
source "drivers/power/supply/samsung/Kconfig"
source "drivers/leds/samsung/Kconfig"
source "drivers/soc/samsung/exynos/debug/Kconfig"
source "drivers/gud/Kconfig"
source "drivers/vision/Kconfig"
source "drivers/staging/nanohub/Kconfig"
source "drivers/misc/samsung/Kconfig"
source "drivers/mfc/Kconfig"
source "drivers/scaler/Kconfig"
source "drivers/smfc/Kconfig"
source "drivers/soc/samsung/xperf/Kconfig"
source "drivers/input/touchscreen/sec_ts/Kconfig"
source "drivers/tee/tzdev/Kconfig"
source "drivers/tee/tui/Kconfig"
source "drivers/camera/Kconfig"
source "drivers/sec_panel_notifier_v2/Kconfig"
source "drivers/usb/typec/slsi/s2mf301/Kconfig"
source "drivers/gpu/drm/samsung/panel/db7f2010b/Kconfig"
source "drivers/gpu/drm/samsung/panel/db7f2010b/kunit_test/Kconfig"
source "drivers/gpu/drm/samsung/panel/oled_common/Kconfig"
source "drivers/usb/typec/slsi/common/Kconfig"
source "drivers/input/sec_input/Kconfig"
source "drivers/vibrator/common/vib_info/Kconfig"
source "drivers/misc/drb/Kconfig"
source "drivers/vibrator/common/Kconfig"
source "drivers/net/dropdump/Kconfig"
source "drivers/muic/common/Kconfig"
source "drivers/input/input_boost/Kconfig"
source "drivers/sti/common/Kconfig"
source "drivers/usb/notify/Kconfig"
source "drivers/battery/core/Kconfig"
source "drivers/kq/mesh/Kconfig"
source "drivers/kperfmon/Kconfig"
source "drivers/gpu/drm/samsung/panel/s6e8fc3/Kconfig"
source "drivers/gpu/drm/samsung/panel/s6e8fc3/kunit_test/Kconfig"
source "drivers/staging/android/switch/Kconfig"
source "drivers/usb/common/vbus_notifier/Kconfig"
source "drivers/usb/typec/manager/Kconfig"
source "drivers/fingerprint/Kconfig"
source "drivers/muic/slsi/platform/Kconfig"
source "drivers/gpu/drm/samsung/panel/Kconfig"
source "drivers/usb/typec/common/Kconfig"
source "drivers/sti/abc/Kconfig"
source "drivers/mfd/slsi/s2mf301/Kconfig"
source "drivers/battery/charger/nu2111a_charger/Kconfig"
source "drivers/muic/slsi/s2mf301/Kconfig"
source "drivers/battery/fuelgauge/s2mf301_fuelgauge/Kconfig"
source "drivers/sensorhub/Kconfig"
source "drivers/sensorhub/debug/Kconfig"
source "drivers/sensorhub/sensor/Kconfig"
source "drivers/sensorhub/sensorhub/Kconfig"
source "drivers/nfc/snvm/Kconfig"
source "drivers/vibrator/dc/Kconfig"
source "drivers/input/touchscreen/focaltech/ft3519/Kconfig"
source "drivers/sensors_lego/Kconfig"
source "drivers/sensorhub/vendor/Kconfig"
source "drivers/battery/charger/s2mf301_charger/Kconfig"
source "drivers/battery/common/Kconfig"
source "drivers/samsung/Kconfig"

endmenu
```
