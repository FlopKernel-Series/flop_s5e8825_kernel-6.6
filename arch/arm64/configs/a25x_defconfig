## drivers/vision/Kconfig
```kconfig
menuconfig VISION_SUPPORT
	tristate "Vision Support"
	select VISION_CORE
	help
	  If you want to use hardware acceleration for vision
	  enable this option and other options below.

if VISION_SUPPORT

source "$(KCONFIG_EXT_SOC_PREFIX)drivers/vision/vision-core/Kconfig"
source "$(KCONFIG_EXT_SOC_PREFIX)drivers/vision/npu/Kconfig"

endif # VISION_SUPPORT
```

## kernel/sched/ems/Kconfig
```kconfig
# SPDX-License-Identifier: GPL-2.0
#
# Samsung SoC drivers
#
#
config VENDOR_NR_CPUS
	int "Maximum number of CPUs (2-4096) governed by vendor"
	range 2 4096
	default "2"

config SCHED_EMS
	tristate "Exynos Mobile Scheduler"
	depends on SMP
	default n
	help
	  This option supports Exynos mobile scheduler.

config SCHED_EMS_TUNE
	bool "Tuner for Exynos Mobile Scheduler"
	depends on SCHED_EMS
	default n
	help
	  This option supports tuner for Exynos mobile scheduler.

config CPU_IDLE_GOV_HALO
        bool "Halo CPU IDLE Governor"
        depends on SCHED_EMS
        default n
        help
          This option supports idle selection for Exynos Mobile scheduler.
```

## sound/soc/codecs/aw882xx/Kconfig
```kconfig
# SPDX-License-Identifier: GPL-2.0

config SND_SMARTPA_AW882XX
	tristate "SoC Audio for Awinic aw882xx series"
	depends on I2C
	help
	  This option enables support for aw882xx series Smart PA.
```

## sound/soc/samsung/exynos/codecs/Kconfig
```kconfig
# SPDX-License-Identifier: GPL-2.0-only

config SND_SOC_S5M3700X
	tristate "S5M3700X CODEC"

config SND_SOC_S5M3700X_DUMP
	tristate "S5M3700X CODEC DUMP"

config SND_SOC_S5M3700X_VTS
	tristate "S5M3700X CODEC VTS"

config SND_SOC_S5M3700X_HIFI
	tristate "S5M3700X CODEC HIFI"
```
