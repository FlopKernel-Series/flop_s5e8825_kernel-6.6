/*
 * SAMSUNG S5E8825 board device tree source
 *
 * Copyright (c) 2020 Samsung Electronics Co., Ltd.
 *		http://www.samsung.com
 *
 * This program is free software; you can redistribute it and/or modify
 * it under the terms of the GNU General Public License version 2 as
 * published by the Free Software Foundation.
*/

#include "s5e8825.m34x_common.dtsi"
#include "s5e8825-m34x_pm_00.dtsi"
#include "camera/s5e8825-m34x-camera_00.dtsi"

/ {
	compatible = "samsung,M34X MEA OPEN", "samsung,S5E8825";

	fragment@model {
		target-path = "/";
		__overlay__ {
			#address-cells = <2>;
			#size-cells = <1>;

			model = "Samsung M34X MEA OPEN based on S5E8825";

			fm@14E90000 {
				status = "disabled";
			};
		}; /* end of __overlay__ */
	}; /* end of fragment */
}; /* end of root */

&serial_0 {
	status = "okay";
};