/* 
 * This pinctrl code is only for PULL state change.
 * IN-OUT setting is set to OUTPUT at fixed-regulator probe.
 */

&pinctrl_4 {
        ldo_gpio1: ldo_gpio1 {
#if 0
		GPIO_CONFIG_PUD(AP,gpf1,gpf1,7, ${set_gpio_output}, PULL_NONE);
#else
		GPIO_CONFIG_PUD(AP,gpf1,gpf1,7, FUNC_OUTPUT_HIGH, PULL_NONE);
#endif
#if 1
		samsung,pin-con-pdn = <3>;
		samsung,pin-pud-pdn = <0>;
#endif
#if 0
		${input_gpio_properties}
#endif
        };
};

&smd {
	fixed_regulator1: fixed_regulator@1 {
		compatible = "regulator-fixed";
#if 1
		regulator-name = "LCD_DDI_VCI";
#else
		regulator-name = "fixed_regulator1";
#endif
		gpio = <SEC_GPIO_REF(AP,gpf1,gpf1,7) 0>;
		pinctrl-names = "default";
		pinctrl-0 = <&ldo_gpio1>;
		enable-active-high;
	};
};

