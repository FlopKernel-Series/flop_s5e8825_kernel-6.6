/*
 * SAMSUNG Device Tree Source
 *
 * Copyright (c) 2023 Samsung Electronics Co., Ltd.
 *		http://www.samsung.com
 *
 * This program is free software; you can redistribute it and/or modify
 * it under the terms of the GNU General Public License version 2 as
 * published by the Free Software Foundation.
 */

/ {
	fragment@sec_wakeup_cpu_allocator {
		target-path = "/";
		__overlay__ {
			sec_wakeup_cpu_allocator {
				compatible = "samsung,sec_wakeup_cpu_allocator";
				start_cpu_num = <6>;
				end_cpu_num = <7>;

				/* dpm_complete resume boosting (held until PM_POST_SUSPEND) */
				boost_enable = <0>;		/* 0: off, 1: on */
				boost_cluster = <1>;		/* 0: little(cpu0-5), 1: big(cpu6-7) */
				boost_freq_khz = <2208000>;	/* cluster min-freq floor (kHz) */
			};
		};
	};
};
