/*
 * SAMSUNG A26XS board device tree source
 *
 * Copyright (c) 2026 Samsung Electronics Co., Ltd.
 *		http://www.samsung.com
 *
 * This program is free software; you can redistribute it and/or modify
 * it under the terms of the GNU General Public License version 2 as
 * published by the Free Software Foundation.
 */

#include "s5e8825.a26xs_common.dtsi"
#include "s5e8825-a26xs_pm_00.dtsi"
#include "camera/s5e8825-a26x-camera_00.dtsi"

#define BOARD_ID	0x1
#define BOARD_REV	0x0

/ {
	compatible = "samsung,s5e8825", "samsung,ERD8825";
	board_id = <BOARD_ID>;
	board_rev = <BOARD_REV>;

	fragment@model {
		target-path = "/";
		__overlay__ {
			#address-cells = <2>;
			#size-cells = <1>;
		}; /* end of __overlay__ */
	}; /* end of fragment */
}; /* end of root */
