## drivers/gpu/drm/samsung/panel/tft_common/Kconfig
```kconfig
menuconfig USDM_PANEL_TFT_COMMON
	tristate "TFT_COMMON DDI Panel Driver"
	depends on USDM_PANEL
	default n
	help
		This enables TFT_COMMON DDI dependent panel drivers of
		common panel driver. say Y, if you have a panel based on
		the TFT_COMMON DDI.
```
